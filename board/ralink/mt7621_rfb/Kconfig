## board/ralink/mt7621_rfb/Kconfig
```kconfig
if BOARD_MT7621_RFB

config SYS_VENDOR
	default "ralink"

config SYS_BOARD
	default "mt7621_rfb"

config SYS_CONFIG_NAME
	default "mt7621"

config DEFAULT_NOR_KERNEL_OFFSET
	hex "Default kernel offset in the NOR"
	default 0x50000
	help
	  This is the fallback value if mtkboardboot command can't
	  retrive the kernel offset from mtdparts.

source "board/ralink/common/Kconfig"

config JDBOOT_COMPATIBLE
	bool "Hack: use jdboot as an alias for mkboardboot"
	default N
	help
	  Default environment of jdcloud_re-cp-02 sets bootcmd=jdboot.
	  Use jdboot as an alias for mkboardboot to compatible with it.

endif
```
